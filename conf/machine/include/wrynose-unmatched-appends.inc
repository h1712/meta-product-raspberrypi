## conf/machine/include/wrynose-unmatched-appends.inc
```bitbake
# Wrynose masks for obsolete or unmatched metadata in RDKE.
# Revisit each entry to port it to Wrynose or retire it; keep masks exact.
BBMASK .= "|${BBFILE_PATTERN_oss-reference}recipes-connectivity/gupnp/gssdp_1\.4\.0\.1\.bbappend$"
BBMASK .= "|${BBFILE_PATTERN_oss-reference}recipes-connectivity/libwebsockets/libwebsockets_4\.2\.%\.bbappend$"
# Match XD4's OpenSSL 3.5.7 baseline; do not apply legacy 1.1.1 appends.
BBMASK .= "|${BBFILE_PATTERN_oss-reference}recipes-connectivity/openssl/openssl_1\.1\.1%\.bbappend$"
BBMASK .= "|${BBFILE_PATTERN_oss-reference}recipes-connectivity/openssl/openssl_1\.1\.1l\.bbappend$"
BBMASK .= "|${BBFILE_PATTERN_oss-reference}recipes-connectivity/openssl/openssl_1\.1\.1l\.bb$"
BBMASK .= "|${BBFILE_PATTERN_oss-reference}recipes-connectivity/openssl-1\.1\.1l/openssl-1\.1\.1l_1\.1\.1l\.bb$"
BBMASK .= "|${BBFILE_PATTERN_oss-reference}recipes-connectivity/openssl-1\.1\.1l/openssl-1\.1\.1l_1\.1\.1l\.bbappend$"
BBMASK .= "|${BBFILE_PATTERN_oss-reference}recipes-connectivity/openssl/openssl_3\.0\.%\.bbappend$"
BBMASK .= "|${BBFILE_PATTERN_oss-reference}recipes-connectivity/openssl/openssl_3\.0\.15\.bbappend$"
BBMASK .= "|${BBFILE_PATTERN_oss-reference}recipes-core/busybox/busybox_1\.35%\.bbappend$"
BBMASK .= "|${BBFILE_PATTERN_oss-reference}recipes-core/dropbear/dropbear_2020\.%\.bbappend$"
BBMASK .= "|${BBFILE_PATTERN_oss-reference}recipes-core/glib-2\.0/glib-2\.0_2\.72\.%\.bbappend$"
BBMASK .= "|${BBFILE_PATTERN_oss-reference}recipes-core/glib-networking/glib-networking_2\.72\.%\.bbappend$"
BBMASK .= "|${BBFILE_PATTERN_oss-reference}recipes-core/glibc/glibc_2\.3%\.bbappend$"
BBMASK .= "|${BBFILE_PATTERN_oss-reference}recipes-core/glibc/glibc_2\.35\.bbappend$"
BBMASK .= "|${BBFILE_PATTERN_oss-reference}recipes-core/libxml2/libxml2_2\.9\.14\.bbappend$"
# Follow XD4's Wrynose systemd 259.5 baseline instead of the legacy 230 recipe.
BBMASK .= "|${BBFILE_PATTERN_oss-reference}recipes-core/systemd/systemd_230\.bb$"
BBMASK .= "|${BBFILE_PATTERN_oss-reference}recipes-core/systemd/systemd_230\.bbappend$"
BBMASK .= "|${BBFILE_PATTERN_oss-reference}recipes-core/systemd/systemd_250\.%\.bbappend$"
BBMASK .= "|${BBFILE_PATTERN_oss-reference}recipes-devtools/abseil-cpp/abseil-cpp_git\.bbappend$"
BBMASK .= "|${BBFILE_PATTERN_oss-reference}recipes-devtools/python/python3_3\.10\.15\.bbappend$"
BBMASK .= "|${BBFILE_PATTERN_oss-reference}recipes-devtools/python/python_2\.7\.%\.bbappend$"
BBMASK .= "|${BBFILE_PATTERN_oss-reference}recipes-extended/pam/libpam_1\.5\.2\.bbappend$"
BBMASK .= "|${BBFILE_PATTERN_oss-reference}recipes-extended/redis/redis_7\.0\.13%\.bbappend$"
BBMASK .= "|${BBFILE_PATTERN_oss-reference}recipes-extended/xz/xz_5\.2\.6\.bbappend$"
BBMASK .= "|${BBFILE_PATTERN_oss-reference}recipes-graphics/cairo/cairo_1\.16\.0\.bbappend$"
BBMASK .= "|${BBFILE_PATTERN_oss-reference}recipes-graphics/freetype/freetype_2\.11\.1\.bbappend$"
BBMASK .= "|${BBFILE_PATTERN_oss-reference}recipes-graphics/harfbuzz/harfbuzz_4\.0\.1\.bbappend$"
BBMASK .= "|${BBFILE_PATTERN_oss-reference}recipes-graphics/spir/spirv-tools_1\.3\.204\.1\.bbappend$"
BBMASK .= "|${BBFILE_PATTERN_oss-reference}recipes-graphics/vulkan/vulkan-tools_1\.3\.204\.1\.bbappend$"
BBMASK .= "|${BBFILE_PATTERN_oss-reference}recipes-kernel/linux-libc-headers/linux-libc-headers_5\.16\.bbappend$"
BBMASK .= "|${BBFILE_PATTERN_oss-reference}recipes-multimedia/alsa/alsa-lib_1\.2\.6%\.bbappend$"
BBMASK .= "|${BBFILE_PATTERN_oss-reference}recipes-multimedia/libomxil/libomxil_%\.bbappend$"
BBMASK .= "|${BBFILE_PATTERN_oss-reference}recipes-multimedia/libomxil/libomxil_0\.9\.%\.bbappend$"
BBMASK .= "|${BBFILE_PATTERN_oss-reference}recipes-multimedia/libpng/libpng_1\.6\.3%\.bbappend$"
BBMASK .= "|${BBFILE_PATTERN_oss-reference}recipes-multimedia/vlc/vlc_3\.0\.17-1\.bbappend$"
BBMASK .= "|${BBFILE_PATTERN_oss-reference}recipes-support/c-ares/c-ares_1\.18\.1\.bbappend$"
BBMASK .= "|${BBFILE_PATTERN_oss-reference}recipes-support/curl/curl_7\.%\.bbappend$"
BBMASK .= "|${BBFILE_PATTERN_oss-reference}recipes-support/curl/curl_7\.82%\.bbappend$"
BBMASK .= "|${BBFILE_PATTERN_oss-reference}recipes-support/curl/curl_7\.82\.0\.bbappend$"
BBMASK .= "|${BBFILE_PATTERN_oss-reference}recipes-support/dlt-daemon/dlt-daemon_2\.18\.%\.bbappend$"
BBMASK .= "|${BBFILE_PATTERN_oss-reference}recipes-support/dnsmasq/dnsmasq_2\.90\.bbappend$"
BBMASK .= "|${BBFILE_PATTERN_oss-reference}recipes-support/fcgi/fcgi_%\.bbappend$"
BBMASK .= "|${BBFILE_PATTERN_oss-reference}recipes-support/gmp/gmp_6\.2\.1\.bbappend$"
BBMASK .= "|${BBFILE_PATTERN_oss-reference}recipes-support/icu/icu_70\.1\.bbappend$"
BBMASK .= "|${BBFILE_PATTERN_oss-reference}recipes-support/libgcrypt/libgcrypt_1\.9%\.bbappend$"
BBMASK .= "|${BBFILE_PATTERN_oss-reference}recipes-support/libsoup/libsoup-2\.4_2\.74\.2\.bbappend$"
BBMASK .= "|${BBFILE_PATTERN_oss-reference}recipes-support/libtinyxml2/libtinyxml2_9\.0\.0\.bbappend$"
BBMASK .= "|${BBFILE_PATTERN_oss-reference}recipes-support/lvm2/lvm2_2\.03\.11\.bbappend$"
BBMASK .= "|${BBFILE_PATTERN_oss-reference}recipes-support/nanomsg/nanomsg_1\.1\.5\.bbappend$"
BBMASK .= "|${BBFILE_PATTERN_oss-reference}recipes-support/neon/neon_0\.30\.2\.bbappend$"
BBMASK .= "|${BBFILE_PATTERN_oss-reference}recipes-support/sqlite/sqlite3_3\.38\.5\.bbappend$"
BBMASK .= "|${BBFILE_PATTERN_oss-reference}recipes-support/wireshark/wireshark_3\.4\.12\.bbappend$"
BBMASK .= "|${BBFILE_PATTERN_oss-vendor-raspberrypi}recipes-graphics/libepoxy/libepoxy_1\.5\.4\.bbappend$"
BBMASK .= "|${BBFILE_PATTERN_oss-vendor-raspberrypi}recipes-graphics/mesa/mesa_%\.bbappend$"
BBMASK .= "|${BBFILE_PATTERN_oss-vendor-raspberrypi}recipes-core/dropbear/dropbear_2020\.%\.bbappend$"
```
